## conf/layer.conf
```bitbake
# We have a conf and classes directory, add to BBPATH
BBPATH =. "${LAYERDIR}:"

# We have recipes-* directories, add to BBFILES
BBFILES += "${LAYERDIR}/recipes-*/*/*.bb \
            ${LAYERDIR}/recipes-*/*/*.bbappend"

BBFILE_COLLECTIONS += "agldemo-ces2023"
BBFILE_PATTERN_agldemo-ces2023 = "^${LAYERDIR}/"
BBFILE_PRIORITY_agldemo-ces2023 = "90"

LAYERSERIES_COMPAT_agldemo-ces2023 = "kirkstone"

LAYERDEPENDS_agldemo-ces2023 = "aglcore agldemo qt5-layer openembedded-layer"
```
